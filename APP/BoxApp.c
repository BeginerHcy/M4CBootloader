#include "mInclude.h"

///////////////////////////////////////////////////////////////
//agv_mode_App AppTask[]={NullApp,BMSApp,CallerApp,ChargeStaionApp,SonarApp};
//cyc_task_fun cycTask[]={cyc2ms,cyc4ms,cyc20ms,cyc100ms,cyc500ms,cycLongTsk};
///////////////////////////////////////////////////////////////
static bool fistBoot = 1;
static uint32_t CNTFlash=0;
float timeBoot = 0;
dwnCtrl_type dwnCtrl={0};

    // CRC 高位字节值表
static const uint8_t s_CRCHi[] = {
    0x00, 0xC1, 0x81, 0x40, 0x01, 0xC0, 0x80, 0x41, 0x01, 0xC0,
    0x80, 0x41, 0x00, 0xC1, 0x81, 0x40, 0x01, 0xC0, 0x80, 0x41,
    0x00, 0xC1, 0x81, 0x40, 0x00, 0xC1, 0x81, 0x40, 0x01, 0xC0,
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    0x80, 0x41, 0x00, 0xC1, 0x81, 0x40
} ;
// CRC 低位字节值表
const uint8_t s_CRCLo[] = {
	0x00, 0xC0, 0xC1, 0x01, 0xC3, 0x03, 0x02, 0xC2, 0xC6, 0x06,
	0x07, 0xC7, 0x05, 0xC5, 0xC4, 0x04, 0xCC, 0x0C, 0x0D, 0xCD,
	0x0F, 0xCF, 0xCE, 0x0E, 0x0A, 0xCA, 0xCB, 0x0B, 0xC9, 0x09,
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	0x43, 0x83, 0x41, 0x81, 0x80, 0x40
};
void cyc100ms(){
	
	if(CNTFlash==0||CNTFlash==2){
		gMachineIO.LED = 1;
		CNTFlash++;
	}
	else if(CNTFlash==1||CNTFlash==3){
		gMachineIO.LED = 0;
		CNTFlash++;
	}	
	else if (CNTFlash>10){
		CNTFlash = 0;
	}
	else{
		CNTFlash++;
	}	
}
void cyc20ms(){
	;
}
void cyc500ms(){
	;
}

void NullApp(){
	
	uint16_t crc;
	
	if(fistBoot==1){
		delay_ms(1000);
		gMachineIO.Uart1Data.sBuffer[0] = 0xDB;
		gMachineIO.Uart1Data.sBuffer[1] = 0x01;
		crc=CRC16_Modbus(&gMachineIO.Uart1Data.sBuffer[0],2);
		gMachineIO.Uart1Data.sBuffer[2] = crc>>8;
		gMachineIO.Uart1Data.sBuffer[3] = crc>>0 & 0xFF; 
		gMachineIO.Uart1Data.sLen = 4;	
		SendUrtBuf(&gMachineIO.Uart1Data,Uartx1);
		fistBoot = 0;
		dwnCtrl.iArry = 0;
		dwnCtrl.demandIndex = 0;
		memset(&dwnCtrl,0,sizeof(dwnCtrl));
	}
	
	switch (dwnCtrl.status){
	
		case 0:
			
			if(capBin(&gMachineIO.Uart1Data)==1){
				
				delay_ms(30);
				
				iap_write_appbin(FLASH_APP1_ADDR+dwnCtrl.index,(u8 *)dwnCtrl.bufAddr,dwnCtrl.numSend);

				gMachineIO.Uart1Data.sBuffer[0] = 0xBA;
				gMachineIO.Uart1Data.sBuffer[1] = 0x01;
				gMachineIO.Uart1Data.sBuffer[2] = dwnCtrl.demandIndex >> 16;
				gMachineIO.Uart1Data.sBuffer[3] = dwnCtrl.demandIndex >> 8;
				gMachineIO.Uart1Data.sBuffer[4] = dwnCtrl.demandIndex >> 0 & 0xFF;
				crc=CRC16_Modbus(&gMachineIO.Uart1Data.sBuffer[0],5);
				gMachineIO.Uart1Data.sBuffer[5] = crc>>8;
				gMachineIO.Uart1Data.sBuffer[6] = crc>>0 & 0xFF; 
				gMachineIO.Uart1Data.sLen = 7;
					
				SendUrtBuf(&gMachineIO.Uart1Data,Uartx1);
				
				dwnCtrl.indexArry[dwnCtrl.iArry]=dwnCtrl.demandIndex;
				dwnCtrl.iArry++;
				if(dwnCtrl.iArry>=100)dwnCtrl.iArry=0;
				timeBoot = 0;	
			}
			if(timeBoot>5.0){		
				if(((*(vu32*)(FLASH_APP1_ADDR+4))&0xFF000000)==0x08000000)//判断是否为0X08XXXXXX.
				{	 
					iap_load_app(FLASH_APP1_ADDR);//执行FLASH APP代码
				}
			}
			break;
		
		case 10:
			
			break;
		
		case 20:
			
			break;
		
		case 30:
			
			break;		
		
		default:
			
			break;
	
	}
	
	if(capStartDwn(&gMachineIO.Uart1Data)==1){	
		delay_ms(10);
		
		gMachineIO.Uart1Data.sBuffer[0] = 0xBB;
		gMachineIO.Uart1Data.sBuffer[1] = 0x01;
		crc=CRC16_Modbus(&gMachineIO.Uart1Data.sBuffer[0],2);
		gMachineIO.Uart1Data.sBuffer[2] = crc>>8;
		gMachineIO.Uart1Data.sBuffer[3] = crc>>0 & 0xFF; 
		gMachineIO.Uart1Data.sLen = 4;	
		SendUrtBuf(&gMachineIO.Uart1Data,Uartx1);
		
		delay_ms(100);
		
		NVIC_SystemReset();
	}
	
	if(capEndDwn(&gMachineIO.Uart1Data)==1){	
		delay_ms(10);
		
		gMachineIO.Uart1Data.sBuffer[0] = 0xBC;
		gMachineIO.Uart1Data.sBuffer[1] = 0x01;
		crc=CRC16_Modbus(&gMachineIO.Uart1Data.sBuffer[0],2);
		gMachineIO.Uart1Data.sBuffer[2] = crc>>8;
		gMachineIO.Uart1Data.sBuffer[3] = crc>>0 & 0xFF; 
		gMachineIO.Uart1Data.sLen = 4;	
		SendUrtBuf(&gMachineIO.Uart1Data,Uartx1);
		
		delay_ms(100);		
		iap_load_app(FLASH_APP1_ADDR);//执行FLASH APP代码
	}
}

bool capStartDwn(UrtBuf_type * pSrcBuf){
	uint8_t filled = pSrcBuf->pRfil;
	uint8_t degred = pSrcBuf->pRder;
	uint16_t crcResult=0;
	uint8_t chnOKBfLen = 4;
	
	bool result=0;
	///
	result = 0;
	///
	if(filled >= degred+ chnOKBfLen)//1. Len enough.
	{
		for(;degred<=filled-1;degred++)
		{
			if(filled >= degred+ chnOKBfLen){
				/////////////////////////////////////
				if(pSrcBuf->rBuffer[degred]==0xAB && 
					pSrcBuf->rBuffer[degred+1]==0x01)
				{
					crcResult = CRC16_Modbus(&pSrcBuf->rBuffer[degred],2);
					if(crcResult == pSrcBuf->rBuffer[degred+2]*256+pSrcBuf->rBuffer[degred+3])
					{
						pSrcBuf->pRder = degred+chnOKBfLen-1;
						result = 1;
					}
				}
			}
		}
	}
	return result;
}

bool capEndDwn(UrtBuf_type * pSrcBuf){
	uint8_t filled = pSrcBuf->pRfil;
	uint8_t degred = pSrcBuf->pRder;
	uint16_t crcResult=0;
	uint8_t chnOKBfLen = 4;
	
	bool result=0;
	///
	result = 0;
	///
	if(filled >= degred+ chnOKBfLen)//1. Len enough.
	{
		for(;degred<=filled-1;degred++)
		{
			if(filled >= degred+ chnOKBfLen){
				/////////////////////////////////////
				if(pSrcBuf->rBuffer[degred]==0xAC && 
					pSrcBuf->rBuffer[degred+1]==0x01)
				{
					crcResult = CRC16_Modbus(&pSrcBuf->rBuffer[degred],2);
					if(crcResult == pSrcBuf->rBuffer[degred+2]*256+pSrcBuf->rBuffer[degred+3])
					{
						pSrcBuf->pRder = degred+chnOKBfLen-1;
						result = 1;
					}
				}
			}
		}
	}
	return result;
}

bool capBin(UrtBuf_type * pSrcBuf){
	uint8_t filled = pSrcBuf->pRfil;
	uint8_t degred = pSrcBuf->pRder;
	uint16_t crcResult=0;
	uint8_t chnOKBfLen = 10;
//	uint32_t index;
	bool result=0;
	///
	result = 0;
	///
	if(filled >= degred+ chnOKBfLen)//1. Len enough.
	{
		for(;degred<=filled-1;degred++)
		{
			if(filled >= degred+ chnOKBfLen){
				/////////////////////////////////////
				if(pSrcBuf->rBuffer[degred]==0xAA && pSrcBuf->rBuffer[degred+7]<=255)
				{
					if(filled>=degred+chnOKBfLen+pSrcBuf->rBuffer[degred+7]){
						crcResult = CRC16_Modbus(&pSrcBuf->rBuffer[degred],8+pSrcBuf->rBuffer[degred+7]);
						if(crcResult == pSrcBuf->rBuffer[degred+8+pSrcBuf->rBuffer[degred+7]]*256 + pSrcBuf->rBuffer[degred+8+pSrcBuf->rBuffer[degred+7]+1])
						{
							dwnCtrl.index = pSrcBuf->rBuffer[degred+1] * 65536 + pSrcBuf->rBuffer[degred+2] * 256 + pSrcBuf->rBuffer[degred+3];
							if(dwnCtrl.index==dwnCtrl.demandIndex){
								dwnCtrl.demandIndex = dwnCtrl.index + pSrcBuf->rBuffer[degred+7];
								dwnCtrl.numSend = pSrcBuf->rBuffer[degred+7];
								dwnCtrl.bufAddr = (uint32_t)&(pSrcBuf->rBuffer[degred+8]);
								pSrcBuf->pRder = degred+chnOKBfLen-1;
								result = 1;
							}
						}
					}
				}
			}
		}
	}
	return result;
}


uint16_t CRC16_Modbus(uint8_t *_pBuf, uint16_t _usLen){
	uint8_t ucCRCHi = 0xFF; /* 高CRC字节初始化 */
	uint8_t ucCRCLo = 0xFF; /* 低CRC 字节初始化 */
	uint16_t usIndex;  /* CRC循环中的索引 */

    while (_usLen--)
    {
			usIndex = ucCRCHi ^ *_pBuf++; /* 计算CRC */
			ucCRCHi = ucCRCLo ^ s_CRCHi[usIndex];
			ucCRCLo = s_CRCLo[usIndex];
    }
    return ((uint16_t)ucCRCHi << 8 | ucCRCLo);
}

